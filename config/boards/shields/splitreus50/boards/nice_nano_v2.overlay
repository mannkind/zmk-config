&spi1 {
	compatible = "nordic,nrf-spim";
	/* Cannot be used together with i2c0. */
	status = "okay";
	// Unused pins, needed for SPI definition, but not used by the ws2812 driver itself.
	mosi-pin = <6>;
	sck-pin = <5>;
	miso-pin = <7>;
};