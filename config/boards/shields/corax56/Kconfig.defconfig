## config/boards/shields/corax56/Kconfig.defconfig
```kconfig
if SHIELD_CORAX56_LEFT

config ZMK_KEYBOARD_NAME
    default "Corax56"

config ZMK_SPLIT_ROLE_CENTRAL
    default y

config ZMK_USB
	default y

endif # SHIELD_CORAX56_LEFT

if SHIELD_CORAX56_LEFT || SHIELD_CORAX56_RIGHT

config ZMK_SPLIT
    default y

config ZMK_BLE
	default y

endif # SHIELD_CORAX56_LEFT || SHIELD_CORAX56_RIGHT
```

## config/boards/shields/corax56/Kconfig.shield
```kconfig
config SHIELD_CORAX56_LEFT
    def_bool $(shields_list_contains,corax56_left)

config SHIELD_CORAX56_RIGHT
    def_bool $(shields_list_contains,corax56_right)
```

## config/boards/shields/sofle_dongle/Kconfig.defconfig
```kconfig
# Copyright (c) 2020 Ryan Cross
# SPDX-License-Identifier: MIT

if SHIELD_SOFLE_DONGLE

config ZMK_KEYBOARD_NAME
	default "Sofle Dongle"
	
config ZMK_SPLIT_BLE_ROLE_CENTRAL
	default y
	
config ZMK_USB
	default y

endif

if SHIELD_SOFLE_DONGLE_LEFT || SHIELD_SOFLE_DONGLE_RIGHT || SHIELD_SOFLE_DONGLE

config ZMK_SPLIT
    default y

config ZMK_BLE
	default y

if ZMK_DISPLAY

config I2C
    default y

config SSD1306
    default y

endif # ZMK_DISPLAY

if LVGL

config LV_Z_VDB_SIZE
    default 64

config LV_DPI_DEF
    default 148

config LV_Z_BITS_PER_PIXEL
    default 1

choice LV_COLOR_DEPTH
    default LV_COLOR_DEPTH_1
endchoice

endif # LVGL

if ZMK_RGB_UNDERGLOW

config WS2812_STRIP
    default y
endif

endif
```

## config/boards/shields/sofle_dongle/Kconfig.shield
```kconfig
# Copyright (c) 2020 Ryan Cross
# SPDX-License-Identifier: MIT

config SHIELD_SOFLE_DONGLE
    def_bool $(shields_list_contains,sofle_dongle)

config SHIELD_SOFLE_DONGLE_LEFT
    def_bool $(shields_list_contains,sofle_dongle_left)

config SHIELD_SOFLE_DONGLE_RIGHT
    def_bool $(shields_list_contains,sofle_dongle_right)
```

## config/boards/shields/splitreus50/Kconfig.defconfig
```kconfig
# Copyright (c) 2021 The ZMK Contributors
# SPDX-License-Identifier: MIT

if SHIELD_SPLITREUS50_LEFT

config ZMK_KEYBOARD_NAME
    default "SPLITREUS50"

#config ZMK_SPLIT_ROLE_CENTRAL
config ZMK_SPLIT_BLE_ROLE_CENTRAL
    default y

endif

if SHIELD_SPLITREUS50_LEFT || SHIELD_SPLITREUS50_RIGHT

config ZMK_SPLIT
	default y

endif
```

## config/boards/shields/splitreus50/Kconfig.shield
```kconfig
# Copyright (c) 2021 The ZMK Contributors
# SPDX-License-Identifier: MIT

config SHIELD_SPLITREUS50_LEFT
    def_bool $(shields_list_contains,splitreus50_left)

config SHIELD_SPLITREUS50_RIGHT
    def_bool $(shields_list_contains,splitreus50_right)
```

## config/west.yml
```yaml
manifest:
  defaults:
    remote: urob
    revision: v0.1

  remotes:
    - name: upstream
      url-base: https://github.com/zmkfirmware
    - name: urob
      url-base: https://github.com/urob

  projects:
    - name: zmk
      remote: urob
      revision: main
      import: app/west.yml
    - name: zmk-helpers
      remote: urob
      revision: v2
  
  self:
    path: config
```
