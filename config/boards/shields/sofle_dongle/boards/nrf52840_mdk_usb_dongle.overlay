/*
 * Copyright (c) 2020 The ZMK Contributors
 *
 * SPDX-License-Identifier: MIT
 */

#include <dt-bindings/zmk/matrix_transform.h>
#include "arduino_pro_micro_pins.dtsi"

/ {

	chosen {
		zmk,kscan = &kscan0;
	};

	kscan0: kscan {
		compatible = "zmk,kscan-gpio-direct";
		label = "KSCAN";
		input-gpios
		= <&gpio0 10 (GPIO_ACTIVE_LOW | GPIO_PULL_UP)>
		;
	};

};

&pro_micro_i2c {
    status = "disabled";
};