/*
 * Copyright (c) 2020 Pete Johanson, Ryan Cross
 *
 * SPDX-License-Identifier: MIT
 */

#include "sofle_dongle_base.dtsi"

/ {
    chosen {
        zmk,kscan = &mock_kscan;
    };

    mock_kscan: kscan_1 {
        compatible = "zmk,kscan-mock";
        columns = <0>;
        rows = <0>;
        events = <0>;
    };
};